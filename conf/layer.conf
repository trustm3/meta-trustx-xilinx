## conf/layer.conf
```bitbake
BBPATH := "${BBPATH}:${LAYERDIR}" 

BBFILES := "${BBFILES} ${LAYERDIR}/recipes-*/*/*.bb \ 
           ${LAYERDIR}/recipes-*/*/*.bbappend \
	   ${LAYERDIR}/images/*.bb*"


BBFILE_COLLECTIONS += "trustx-xilinx"
BBFILE_PATTERN_trustx-xilinx := "^${LAYERDIR}/"
BBFILE_PRIORITY_trustx-xilinx := "8"

LAYERDEPENDS_trustx-xilinx = "trustx-layer xilinx-tools"

LAYERSERIES_COMPAT_trustx-xilinx += "rocko thud warrior"
```
